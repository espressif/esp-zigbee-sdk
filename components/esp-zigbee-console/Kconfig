## examples/zigbee_gateway/main/Kconfig.projbuild
```kconfig
menu "ESP Zigbee gateway rcp update"
    depends on ZB_RADIO_SPINEL_UART
    menu "Board Configuration"
        config PIN_TO_RCP_RESET
            int "Pin to RCP reset"
            default "7"

        config PIN_TO_RCP_BOOT
            int "Pin to RCP boot"
            default "8"

        config PIN_TO_RCP_TX
            int "Pin to RCP TX"
            default "17"

        config PIN_TO_RCP_RX
            int "Pin to RCP RX"
            default "18"
    endmenu
    
    config ZIGBEE_GW_AUTO_UPDATE_RCP
        bool 'Update RCP automatically'
        default True
        help
            If enabled, the Zigbee gateway will store the RCP image in its firmware and
            compare the stored image version with the running RCP image upon boot. The RCP
            will be automatically updated upon version mismatch.

    choice ZIGBEE_GW_RCP_CHIP
        prompt "Zigbee gateway RCP chip"
        depends on ZIGBEE_GW_AUTO_UPDATE_RCP
        default ZIGBEE_GW_RCP_CHIP_ESP32H2
        help
            Select the RCP chip connected to the Zigbee gateway.

        config ZIGBEE_GW_RCP_CHIP_ESP32H2
            bool "ESP32-H2"
            help
                ESP32-H2 is the RCP chip connected to the Zigbee gateway.
        config ZIGBEE_GW_RCP_CHIP_ESP32C6
            bool "ESP32-C6"
            help
                ESP32-C6 is the RCP chip connected to the Zigbee gateway.
    endchoice

endmenu
```

## examples/zigbee_gateway/sdkconfig.defaults.esp32p4
```kconfig
CONFIG_LWIP_PPP_SUPPORT=y
CONFIG_LWIP_PPP_SERVER_SUPPORT=y

CONFIG_EXAMPLE_USE_INTERNAL_ETHERNET=y
CONFIG_ZIGBEE_GW_AUTO_UPDATE_RCP=y
CONFIG_PIN_TO_RCP_RESET=7
CONFIG_PIN_TO_RCP_BOOT=8
CONFIG_PIN_TO_RCP_TX=4
CONFIG_PIN_TO_RCP_RX=5
CONFIG_ZIGBEE_GW_RCP_CHIP_ESP32C6=y
```
