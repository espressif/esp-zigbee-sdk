## components/esp-zigbee-console/Kconfig
```kconfig
menu "Zigbee Console"
    depends on ZB_ENABLED

    config ZB_CONSOLE_ENABLED
        bool "Enable Zigbee Console"
        depends on ZB_ENABLED
        default y
        help
            Select this option to enable Zigbee Console

    config ZB_CONSOLE_MAX_LINE_LENGTH
        int "Set max line length of Zigbee Console"
        depends on ZB_CONSOLE_ENABLED
        default 0
        help
            The max line length of Zigbee Console, "0" means system default

endmenu
```

## examples/esp_zigbee_all_device_types_app2/sdkconfig.defaults
```kconfig
# Reduce bootloader log verbosity
CONFIG_BOOTLOADER_LOG_LEVEL_WARN=y
CONFIG_BOOTLOADER_LOG_LEVEL=2

# Enable filesystem
CONFIG_PARTITION_TABLE_CUSTOM=y
CONFIG_PARTITION_TABLE_CUSTOM_FILENAME="partitions.csv"
CONFIG_PARTITION_TABLE_FILENAME="partitions.csv"

#
# Zboss
#
CONFIG_ZB_ENABLED=y
CONFIG_ZB_ZCZR=y
# end of Zboss
# end of Component config
```

## examples/esp_zigbee_cli/main/Kconfig.projbuild
```kconfig
menu "ESP Zigbee CLI example"

    menu "Board UART port Configuration"
    depends on ZB_RADIO_SPINEL_UART
        config PIN_TO_RCP_TX
            int "Pin to RCP TX"
            default "5"

        config PIN_TO_RCP_RX
            int "Pin to RCP RX"
            default "4"
    endmenu
    
    config ZB_CLI_ENABLE
        bool 'Enable CLI command functions'
        default True
        help
            This has to be always enabled if we use CLI example
endmenu
```

## examples/esp_zigbee_cli/sdkconfig.defaults
```kconfig
# Reduce bootloader log verbosity
CONFIG_BOOTLOADER_LOG_LEVEL_WARN=y
CONFIG_BOOTLOADER_LOG_LEVEL=2

# Increase main task stack size
CONFIG_ESP_MAIN_TASK_STACK_SIZE=7168

# Enable filesystem
CONFIG_PARTITION_TABLE_CUSTOM=y
CONFIG_PARTITION_TABLE_CUSTOM_FILENAME="partitions.csv"
CONFIG_PARTITION_TABLE_FILENAME="partitions.csv"

# Enable FreeRTOS stats formatting functions, needed for 'tasks' command
CONFIG_FREERTOS_USE_TRACE_FACILITY=y
CONFIG_FREERTOS_USE_STATS_FORMATTING_FUNCTIONS=y

#
# Zboss
#
CONFIG_ZB_ENABLED=y
CONFIG_ZB_ZCZR=y
CONFIG_ZB_CLI_ENABLE=y
# CONFIG_ZB_ZED is not set
# end of Zboss

#
# IEEE802154
#
CONFIG_IEEE802154_RECEIVE_DONE_HANDLER=y
# end of IEEE802154
# end of Component config
```

## examples/esp_zigbee_gateway/sdkconfig.defaults
```kconfig
#
# Partition Table
#
CONFIG_PARTITION_TABLE_CUSTOM=y
CONFIG_PARTITION_TABLE_CUSTOM_FILENAME="partitions.csv"
CONFIG_PARTITION_TABLE_FILENAME="partitions.csv"
CONFIG_PARTITION_TABLE_OFFSET=0x8000
CONFIG_PARTITION_TABLE_MD5=y
# end of Partition Table

#
# Serial flasher config
#
CONFIG_ESPTOOLPY_FLASHSIZE_4MB=y
# end of Serial flasher config

#
# mbedTLS
#
CONFIG_MBEDTLS_HARDWARE_AES=n
CONFIG_MBEDTLS_HARDWARE_MPI=n
CONFIG_MBEDTLS_HARDWARE_SHA=n
CONFIG_MBEDTLS_CMAC_C=y
CONFIG_MBEDTLS_SSL_PROTO_DTLS=y
CONFIG_MBEDTLS_KEY_EXCHANGE_ECJPAKE=y
# end of TLS Key Exchange Methods

CONFIG_MBEDTLS_ECJPAKE_C=y
# end of mbedTLS

CONFIG_ESP_SYSTEM_EVENT_TASK_STACK_SIZE=4096

#
# Zboss
#
CONFIG_ZB_ENABLED=y
CONFIG_ZB_ZCZR=y
# end of Zboss
# end of Component config

#
# ESP Zigbee gateway rcp update
#
CONFIG_ZIGBEE_GW_AUTO_UPDATE_RCP=n
#
# Board Configuration
#
CONFIG_PIN_TO_RCP_RESET=7
CONFIG_PIN_TO_RCP_BOOT=8
CONFIG_PIN_TO_RCP_TX=17
CONFIG_PIN_TO_RCP_RX=18

# end of ESP Zigbee gateway rcp update

#
# IEEE802154
#
CONFIG_IEEE802154_RECEIVE_DONE_HANDLER=y
# end of IEEE802154
```

## examples/esp_zigbee_host/components/Kconfig
```kconfig
menu "Zigbee NCP Host"

    choice HOST_BUS_MODE
        bool "Host Connection Mode"
        default HOST_BUS_MODE_UART
        help
            Select which mode does the device connection with the host, support UART.

        config HOST_BUS_MODE_UART
            bool "UART"
    endchoice

    config HOST_BUS_MODE
        int
        default 0 if HOST_BUS_MODE_UART

    if HOST_BUS_MODE_UART
        config HOST_BUS_UART_BAUD_RATE
            int 
            default 115200
            range 9600 891200
            prompt "UART baud rate"
            help
                Set UART baud rate.
        
        config HOST_BUS_UART_BYTE_SIZE
            int 
            default 3
            range 0 3
            prompt "UART word length"
            help
                Set UART word length are defined as follows:

                - 0x0: 5bits
                - 0x1: 6bits
                - 0x2: 7bits
                - 0x3: 8bits

        config HOST_BUS_UART_STOP_BITS
            int 
            default 1
            range 1 3
            prompt "UART stop bits"
            help
                Set UART stop bits are defined as follows:

                - 0x1, 1bit
                - 0x2, 1.5bits
                - 0x3, 2bits

        config HOST_BUS_UART_FLOW_CONTROL
            int 
            default 0
            range 0 3
            prompt "UART HW flow control mode"
            help
                Set UART HW flow control mode are defined as follows:

                - 0x0, disable hardware flow control
                - 0x1, enable RX hardware flow control (rts)
                - 0x2, enable TX hardware flow control (cts)
                - 0x3, enable hardware flow control
        
        config HOST_BUS_UART_NUM
            int
            range 0 2
            default 1
            prompt "UART number"
            help
                Set UART number.
        
        config HOST_BUS_UART_RX_PIN
            int 
            default -1
            range -1 30
            prompt "UART RX pin"
            help
                Set UART RX pin.
        
        config HOST_BUS_UART_TX_PIN
            int 
            default -1
            range -1 30
            prompt "UART TX pin"
            help
                Set UART TX pin.
        
        config HOST_BUS_UART_RTS_PIN
            int 
            default -1
            range -1 30
            prompt "UART rts pin"
            help
                Set UART rts pin.
        
        config HOST_BUS_UART_CTS_PIN
            int 
            default -1
            range -1 30
            prompt "UART cts pin"
            help
                Set UART cts pin.

    endif # HOST_BUS_MODE_UART

endmenu
```

## examples/esp_zigbee_ota/ota_client/main/Kconfig
```kconfig
menu "Example OTA Configuration"

    choice ZB_OTA
        prompt "Configure the OTA mode"
        default ZB_NORMAL_OTA
        help
            Select which mode does the device OTA, support Normal/Delta.

        config ZB_NORMAL_OTA
            bool 'Normal OTA Updates'
            help
                Select this to enable the OTA with normal binaries.

        config ZB_DELTA_OTA
            bool 'Delta OTA Updates'
            help
                Select this to enable the OTA with compressed delta binaries.
    endchoice

endmenu
```

## examples/esp_zigbee_ota/ota_client/managed_components/espressif__esp_delta_ota/examples/https_delta_ota/main/Kconfig.projbuild
```kconfig
menu "Example Configuration"

    config EXAMPLE_FIRMWARE_UPG_URL
        string "Firmware Upgrade URL"
        default "https://192.168.20.194:8070/patch.bin"
        help
            URL of server which hosts the firmware image.

    config EXAMPLE_SKIP_COMMON_NAME_CHECK
        bool "Skip server certificate CN fieldcheck"
        default n
        help
            This allows you to skip the validation of OTA server certificate CN field.

    config EXAMPLE_SKIP_VERSION_CHECK
        bool "Skip firmware version check"
        default n
        help
            This allows you to skip the firmware version check.

    config EXAMPLE_OTA_RECV_TIMEOUT
        int "OTA Receive Timeout"
        default 5000
        help
            Maximum time for reception

endmenu
```

## examples/esp_zigbee_ota/ota_client/sdkconfig.defaults
```kconfig
#
# Serial flasher config
#
CONFIG_ESPTOOLPY_FLASHSIZE_4MB=y
# end of Serial flasher config

#
# Partition Table
#
CONFIG_PARTITION_TABLE_CUSTOM=y
CONFIG_PARTITION_TABLE_CUSTOM_FILENAME="partitions.csv"
CONFIG_PARTITION_TABLE_FILENAME="partitions.csv"
CONFIG_PARTITION_TABLE_OFFSET=0x8000
CONFIG_PARTITION_TABLE_MD5=y
# end of Partition Table

#
# mbedTLS
#
CONFIG_MBEDTLS_HARDWARE_AES=n
CONFIG_MBEDTLS_HARDWARE_MPI=n
CONFIG_MBEDTLS_HARDWARE_SHA=n
CONFIG_MBEDTLS_CMAC_C=y
CONFIG_MBEDTLS_SSL_PROTO_DTLS=y
CONFIG_MBEDTLS_KEY_EXCHANGE_ECJPAKE=y
# end of TLS Key Exchange Methods

CONFIG_MBEDTLS_ECJPAKE_C=y
# end of mbedTLS

#
# Zboss
#
CONFIG_ZB_ENABLED=y
CONFIG_ZB_ZED=y
# end of Zboss
# end of Component config

#
# Flash Size
#
CONFIG_ESPTOOLPY_FLASHSIZE_2MB=y
# CONFIG_ESPTOOLPY_FLASHSIZE_4MB is not set
# CONFIG_ESPTOOLPY_FLASHSIZE_8MB is not set
# CONFIG_ESPTOOLPY_FLASHSIZE_16MB is not set
# CONFIG_ESPTOOLPY_FLASHSIZE_32MB is not set
# CONFIG_ESPTOOLPY_FLASHSIZE_64MB is not set
# CONFIG_ESPTOOLPY_FLASHSIZE_128MB is not set
CONFIG_ESPTOOLPY_FLASHSIZE="2MB"
# end of Flash Size

#
# IEEE802154
#
CONFIG_IEEE802154_RECEIVE_DONE_HANDLER=y
# end of IEEE802154
# end of Component config
```

## examples/esp_zigbee_sleep/deep_sleep/sdkconfig.defaults
```kconfig
#
# Partition Table
#
CONFIG_PARTITION_TABLE_CUSTOM=y
CONFIG_PARTITION_TABLE_CUSTOM_FILENAME="partitions.csv"
CONFIG_PARTITION_TABLE_FILENAME="partitions.csv"
CONFIG_PARTITION_TABLE_OFFSET=0x8000
CONFIG_PARTITION_TABLE_MD5=y
# end of Partition Table

#
# mbedTLS
#
CONFIG_MBEDTLS_HARDWARE_AES=n
CONFIG_MBEDTLS_HARDWARE_MPI=n
CONFIG_MBEDTLS_HARDWARE_SHA=n
CONFIG_MBEDTLS_CMAC_C=y
CONFIG_MBEDTLS_SSL_PROTO_DTLS=y
CONFIG_MBEDTLS_KEY_EXCHANGE_ECJPAKE=y
# end of TLS Key Exchange Methods

CONFIG_MBEDTLS_ECJPAKE_C=y
# end of mbedTLS

#
# Zboss
#
CONFIG_ZB_ENABLED=y
CONFIG_ZB_ZED=y
# end of Zboss
# end of Component config

#
# deep sleep
#
CONFIG_ULP_COPROC_ENABLED=y
CONFIG_ULP_COPROC_RESERVE_MEM=512
CONFIG_NEWLIB_TIME_SYSCALL_USE_RTC_HRT=y
CONFIG_RTC_CLK_SRC_INT_RC=y
CONFIG_BOOTLOADER_SKIP_VALIDATE_IN_DEEP_SLEEP=y

#
# IEEE802154
#
CONFIG_IEEE802154_RECEIVE_DONE_HANDLER=y
# end of IEEE802154
```

## examples/esp_zigbee_sleep/light_sleep/main/Kconfig.projbuild
```kconfig
menu "ESP Zigbee Light Sleep Example"
    config GPIO_INPUT_IO_WAKEUP
        int "GPIO wakeup number"
        default 9 if IDF_TARGET_ESP32H2
        default 7 if IDF_TARGET_ESP32C6
        range 7 14 if IDF_TARGET_ESP32H2
        range 0 7 if IDF_TARGET_ESP32C6

        help
            On ESP32-H2 devkits, the BOOT button is connected to GPIO9, so it can be used to wake up the SoC directly.
            On ESP32-C6 devkits, pull down GPIO7 to wake up the SoC.
endmenu
```

## examples/esp_zigbee_sleep/light_sleep/sdkconfig.defaults
```kconfig
#
# Partition Table
#
CONFIG_PARTITION_TABLE_CUSTOM=y
CONFIG_PARTITION_TABLE_CUSTOM_FILENAME="partitions.csv"
CONFIG_PARTITION_TABLE_FILENAME="partitions.csv"
CONFIG_PARTITION_TABLE_OFFSET=0x8000
CONFIG_PARTITION_TABLE_MD5=y
# end of Partition Table

#
# mbedTLS
#
CONFIG_MBEDTLS_HARDWARE_AES=n
CONFIG_MBEDTLS_HARDWARE_MPI=n
CONFIG_MBEDTLS_HARDWARE_SHA=n
CONFIG_MBEDTLS_CMAC_C=y
CONFIG_MBEDTLS_SSL_PROTO_DTLS=y
CONFIG_MBEDTLS_KEY_EXCHANGE_ECJPAKE=y
# end of TLS Key Exchange Methods

CONFIG_MBEDTLS_ECJPAKE_C=y
# end of mbedTLS

#
# Zboss
#
CONFIG_ZB_ENABLED=y
CONFIG_ZB_ZED=y
# end of Zboss
# end of Component config


#
# light sleep
#
CONFIG_PM_ENABLE=y
CONFIG_FREERTOS_USE_TICKLESS_IDLE=y
CONFIG_PM_POWER_DOWN_PERIPHERAL_IN_LIGHT_SLEEP=y
CONFIG_IEEE802154_SLEEP_ENABLE=y
# Use 1000Hz freertos tick to lower sleep time threshold
CONFIG_FREERTOS_HZ=1000
CONFIG_ESP_SLEEP_POWER_DOWN_FLASH=y
# end of light sleep

#
# IEEE802154
#
CONFIG_IEEE802154_RECEIVE_DONE_HANDLER=y
# end of IEEE802154
```

## examples/project/sdkconfig.defaults
```kconfig
# Reduce bootloader log verbosity
CONFIG_BOOTLOADER_LOG_LEVEL_WARN=y
CONFIG_BOOTLOADER_LOG_LEVEL=2

# Enable filesystem
CONFIG_PARTITION_TABLE_CUSTOM=y
CONFIG_PARTITION_TABLE_CUSTOM_FILENAME="partitions.csv"
CONFIG_PARTITION_TABLE_FILENAME="partitions.csv"
```

## examples/sleepy_devices/deep_sleep_end_device/sdkconfig.defaults
```kconfig
#
# Partition Table
#
CONFIG_PARTITION_TABLE_CUSTOM=y
CONFIG_PARTITION_TABLE_CUSTOM_FILENAME="partitions.csv"
# end of Partition Table

#
# Zigbee
#
CONFIG_ZB_ENABLED=y
CONFIG_ZB_ZED=y
# end of Zigbee

#
# deep sleep
#
CONFIG_ULP_COPROC_ENABLED=y
CONFIG_ULP_COPROC_RESERVE_MEM=512
CONFIG_NEWLIB_TIME_SYSCALL_USE_RTC_HRT=y
CONFIG_RTC_CLK_SRC_INT_RC=y
CONFIG_BOOTLOADER_SKIP_VALIDATE_IN_DEEP_SLEEP=y
```

## examples/sleepy_devices/light_sleep_end_device/sdkconfig.defaults
```kconfig
#
# Partition Table
#
CONFIG_PARTITION_TABLE_CUSTOM=y
CONFIG_PARTITION_TABLE_CUSTOM_FILENAME="partitions.csv"
# end of Partition Table

#
# Zigbee
#
CONFIG_ZB_ENABLED=y
CONFIG_ZB_ZED=y
# end of Zigbee

#
# light sleep
#
CONFIG_PM_ENABLE=y
CONFIG_FREERTOS_USE_TICKLESS_IDLE=y
CONFIG_PM_POWER_DOWN_PERIPHERAL_IN_LIGHT_SLEEP=y
CONFIG_IEEE802154_SLEEP_ENABLE=y
CONFIG_FREERTOS_HZ=1000
CONFIG_ESP_SLEEP_POWER_DOWN_FLASH=y
# end of light sleep
```

## examples/utils/example_common/Kconfig
```kconfig
menu "Zigbee Example Configuration"

    config ZB_EXAMPLE_CHANNEL_CI_ASSIGNMENT
        bool "Select per-chip channel for examples in CI"
        default n
        help
            When enabled, the default values of ZB_EXAMPLE_PRIMARY_CHANNEL and
            ZB_EXAMPLE_SECONDARY_CHANNEL_MASK follow the build target, so that
            concurrent CI test runs of different chip families do not interfere
            with each other over the air. Intended for CI; the values below can
            still be overridden via menuconfig.

    config ZB_EXAMPLE_PRIMARY_CHANNEL
        int "Zigbee Example Primary Channel"
        range 11 26
        default 11 if ZB_EXAMPLE_CHANNEL_CI_ASSIGNMENT && IDF_TARGET_ESP32H2
        default 13 if ZB_EXAMPLE_CHANNEL_CI_ASSIGNMENT && IDF_TARGET_ESP32C6
        default 15 if ZB_EXAMPLE_CHANNEL_CI_ASSIGNMENT && IDF_TARGET_ESP32C5
        default 17 if ZB_EXAMPLE_CHANNEL_CI_ASSIGNMENT && IDF_TARGET_ESP32P4
        default 19 if ZB_EXAMPLE_CHANNEL_CI_ASSIGNMENT && IDF_TARGET_ESP32S3
        default 21 if ZB_EXAMPLE_CHANNEL_CI_ASSIGNMENT && IDF_TARGET_ESP32S31
        default 13
        help
            Primary Zigbee channel the example forms/joins on. When
            ZB_EXAMPLE_CHANNEL_CI_ASSIGNMENT is enabled the default follows the build
            target (per-chip RF isolation); otherwise it defaults to 13.

    config ZB_EXAMPLE_SECONDARY_CHANNEL_MASK
        hex "Zigbee Example Secondary Channel Mask"
        default 0x00000800 if ZB_EXAMPLE_CHANNEL_CI_ASSIGNMENT && IDF_TARGET_ESP32H2
        default 0x00002000 if ZB_EXAMPLE_CHANNEL_CI_ASSIGNMENT && IDF_TARGET_ESP32C6
        default 0x00008000 if ZB_EXAMPLE_CHANNEL_CI_ASSIGNMENT && IDF_TARGET_ESP32C5
        default 0x00020000 if ZB_EXAMPLE_CHANNEL_CI_ASSIGNMENT && IDF_TARGET_ESP32P4
        default 0x00080000 if ZB_EXAMPLE_CHANNEL_CI_ASSIGNMENT && IDF_TARGET_ESP32S3
        default 0x00200000 if ZB_EXAMPLE_CHANNEL_CI_ASSIGNMENT && IDF_TARGET_ESP32S31
        default 0x07FFF800
        help
            Secondary (fallback) Zigbee channel mask. When ZB_EXAMPLE_CHANNEL_CI_ASSIGNMENT
            is enabled the default is the single per-chip channel mask (RF
            isolation); otherwise it defaults to all channels (0x07FFF800).

endmenu
```
