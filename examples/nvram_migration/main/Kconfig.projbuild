## examples/nvram_migration/main/Kconfig.projbuild
```kconfig
menu "Zigbee NVRAM Migration Example"

    config ZB_EXAMPLE_RUNTIME_NVS_PARTITION
        bool "Using NVS partition added at runtime"
        default n
        help
            When enabled, the NVS partition for Zigbee dataset storage will be created at runtime,
            instead of the pre-defined one in the partition table. This is useful when the old device
            does not have a NVS partition or the pre-defined NVS partition does not have enough space
            for Zigbee dataset storage.

endmenu
```

## examples/zigbee_gateway/sdkconfig.defaults.esp32s3
```kconfig
CONFIG_AUTO_UPDATE_RCP=y
CONFIG_DEFAULT_PIN_TO_RCP_RESET=7
CONFIG_DEFAULT_PIN_TO_RCP_BOOT=8
CONFIG_DEFAULT_PIN_TO_RCP_TX=17
CONFIG_DEFAULT_PIN_TO_RCP_RX=18
CONFIG_RCP_PARTITION_NAME="rcp_fw"
CONFIG_ZB_GW_RCP_CHIP_ESP32H2=y
CONFIG_EXAMPLE_WIFI_SSID="zigbee_ci_1"
CONFIG_EXAMPLE_WIFI_PASSWORD="espressif"
```
